/*
 * Copyright 2016 Lothar Waßmann <LW@KARO-electronics.de>
 * Copyright 2016 Oliver Wendt <OW@KARO-electronics.de>
 * Copyright 2016 Michael Vyskocil <MV@KARO-electronics.de>
 * Copyright 2018 Daniel Wagener <daniel.wagener@kernelconcepts.de>
 *
 * This file is dual-licensed: you can use it either under the terms
 * of the GPL or the X11 license, at your option. Note that this dual
 * licensing only applies to this file, and not this project as a
 * whole.
 *
 *  a) This file is free software; you can redistribute it and/or
 *     modify it under the terms of the GNU General Public License
 *     version 2 as published by the Free Software Foundation.
 *
 *     This file is distributed in the hope that it will be useful,
 *     but WITHOUT ANY WARRANTY; without even the implied warranty of
 *     MERCHANTABILITY or FITNESS FOR A PARTICULAR PURPOSE.  See the
 *     GNU General Public License for more details.
 *
 * Or, alternatively,
 *
 *  b) Permission is hereby granted, free of charge, to any person
 *     obtaining a copy of this software and associated documentation
 *     files (the "Software"), to deal in the Software without
 *     restriction, including without limitation the rights to use,
 *     copy, modify, merge, publish, distribute, sublicense, and/or
 *     sell copies of the Software, and to permit persons to whom the
 *     Software is furnished to do so, subject to the following
 *     conditions:
 *
 *     The above copyright notice and this permission notice shall be
 *     included in all copies or substantial portions of the Software.
 *
 *     THE SOFTWARE IS PROVIDED "AS IS", WITHOUT WARRANTY OF ANY KIND,
 *     EXPRESS OR IMPLIED, INCLUDING BUT NOT LIMITED TO THE WARRANTIES
 *     OF MERCHANTABILITY, FITNESS FOR A PARTICULAR PURPOSE AND
 *     NONINFRINGEMENT. IN NO EVENT SHALL THE AUTHORS OR COPYRIGHT
 *     HOLDERS BE LIABLE FOR ANY CLAIM, DAMAGES OR OTHER LIABILITY,
 *     WHETHER IN AN ACTION OF CONTRACT, TORT OR OTHERWISE, ARISING
 *     FROM, OUT OF OR IN CONNECTION WITH THE SOFTWARE OR THE USE OR
 *     OTHER DEALINGS IN THE SOFTWARE.
 */

/*
 * Please be reminded that - in general - DTSI file(s) are include files that
 * are for more than one purpose (usually bound to a SoC) and as such shouldn't
 * be edited. For end-user products it should be the DTS file(s) that choose
 * which devices and pins are active and setup.
 *
 * The setup of DT files for Ka-Ro TX COM Modules under Yocto follow a
 * different, non-standard, implementation to the mainline Linux kernel.
 */

/*
 * Please see the imx6*-tx6-gpio.h && imx6*-tx6.dtsi in "linux-karo-x.y.ab/tx6"
 * for the definitions like TX_NAND or TX_EMMC, etc.
 */

/dts-v1/;

#include "imx6dl.dtsi"
#include "imx6qdl-tx6.dtsi"
#include "txbase-pl-161.dtsi"
#include "imx6dl-tx6-emmc-pl-161-version.dtsi"
#include <dt-bindings/thermal/thermal.h>

/ {
	model = "JK pl-161 board based on Ka-Ro TX6U-8133";
	compatible = "karo,imx6dl-tx6dl", "fsl,imx6dl";

	gpio-keys {
		compatible = "gpio-keys";
		pinctrl-names = "default";
		pinctrl-0 = <&pinctrl_gpio_buttons>;
		status = "okay";
		testmode {
			label = "GPIO Input Testmode";
			gpios = <TX_GPIO_PIN158 GPIO_ACTIVE_HIGH>;
			linux,code = <KEY_ESC>;
			status = "okay";
		};
		powerfail {
			label = "GPIO Input Powerfail";
			gpios = <TX_GPIO_PIN155 GPIO_ACTIVE_HIGH>;
			linux,code = <KEY_F12>;
			status = "okay";
		};
		uv {
			label = "GPIO Input UV";
			gpios = <TX_GPIO_PIN157 GPIO_ACTIVE_HIGH>;
			linux,code = <KEY_F12>;
			status = "okay";
		};
	};
	thermal-zones {
		cpu_thermal: cpu-thermal {
			polling-delay-passive = <1000>; /* milliseconds */
			polling-delay = <2000>; /* milliseconds */
			thermal-sensors = <&tempmon 1>;
			trips {
				cpu_alert0: cpu-alert0 {
					temperature = <60000>; /* millicelsius */
					hysteresis = <2000>; /* millicelsius */
					type = "active";
				};
			};
			cooling-maps {
				map0 {
					trip = <&cpu_alert0>;
					cooling-device = <&gpio_fan_cool 1 THERMAL_NO_LIMIT>;
				};
			};
		};
	};
	gpio_fan_cool: gpio_fan {
		compatible = "gpio-fan";
		gpios = <TX_GPIO_PIN159 GPIO_ACTIVE_HIGH>;
		gpio-fan,speed-map =    <0    0>,
		                        <1000 1>;
		#cooling-cells = <2>; /* min followed by max */
	};
};

/*
 * Every VOU is multi parted: backlight, device, framebuffer, pwm
 * Thus all parts have to be enabled before a display can be used on the
 * specific port.
 */

&backlight0 {
	status = "okay";
};

/*
 * NVM setup
 */

TX_EMMC {
	status = "okay";
};

/*
 * Remaining device references in alphabetical order
 */

TX_LDB {
	status = "okay";

	lvds0: lvds-channel@0 {
		status = "okay";
		/*
		 * Users should add their custom (U-Boot) timing here,
		 * therewith overwriting the default/pre-defined timings. For more see:
		 *
		 * txbase/{BASEBOARD}-{DISPLAY-IF}/txbase-{BASEBOARD}-{DISPLAY-IF}.dtsi
		 *
		 * e.g.:
		 * txbase/mb7-lvds/txbase-aclavis.dtsi
		 */
	};

	lvds1: lvds-channel@1 {
		status = "okay";
		/*
		 * Users should add their custom (U-Boot) timing here,
		 * therewith overwriting the default/pre-defined timings. For more see:
		 *
		 * txbase/{BASEBOARD}-{DISPLAY-IF}/txbase-{BASEBOARD}-{DISPLAY-IF}.dtsi
		 *
		 * e.g.:
		 * txbase/mb7-lvds/txbase-aclavis.dtsi
		 */
	};
};

TX_LDB_FB1 {
	status = "okay";
};

TX_LDB_FB2 {
	status = "okay";
};

&tempmon {
	#thermal-sensor-cells = <1>;
};

&pinctrl_hog {
	fsl,pins = <
		MX6QDL_PAD_SD3_DAT2__GPIO7_IO06		0x1b0b1 /* ETN PHY RESET */
		MX6QDL_PAD_SD3_DAT4__GPIO7_IO01		0x1b0b1 /* ETN PHY INT */
		MX6QDL_PAD_DI0_DISP_CLK__GPIO4_IO16	0x1b0b0
	>;
};
